/*
 * funcs.c
 *
 * Created: 10/09/2021 13:40:38
 *  Author: Scott Porter
 */ 

#include "funcs.h"

// Used by interrupt handler to update the LED matrix
volatile uint8_t currentCol=0;
volatile uint8_t activeBuffer=0,drawBuffer=1;
volatile uint8_t switchBuffer=0;
volatile uint8_t buffOff=0;
volatile uint8_t cBit=0;

// Current video mode. "SLOW" mode allows for two brightnesses (plus black), "FAST" mode is
// either full brightness or black, but uses less CPU time to update the display. I use "FAST"
// mode in the game-of-life animation, to make calculations faster, as the animation doesn't 
// need 2 brightnesses anyway!
uint8_t videoMode=VIDEO_MODE_SLOW;

// Current button state as a bit field
uint8_t butState=0;

// Display buffers (one is always active, the other is available for writing, so we can flip quickly and avoid glitching)
uint8_t buffer[2][MAX_COL*2]={0};

// Character set (A-Z 0-9) - used to scroll text vertically
const uint8_t charDef[576] = {
	0x18,0x03,0x1c,0x07,0x0c,0x06,0x1c,0x07,0x1c,0x07,0x0c,0x06,0x0c,0x06,0x0c,0x06, // 0
	0x1c,0x03,0x1c,0x07,0x0c,0x06,0x1c,0x03,0x1c,0x03,0x0c,0x06,0x1c,0x07,0x1c,0x03, // 1
	0x18,0x03,0x1c,0x07,0x0c,0x00,0x0c,0x00,0x0c,0x00,0x0c,0x00,0x1c,0x07,0x18,0x03, // 2
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	0x18,0x03,0x1c,0x07,0x0c,0x06,0x1c,0x07,0x18,0x07,0x00,0x06,0x1c,0x07,0x1c,0x03, // 35
};

// Animation of spinning Solder logo - users can use left/right to rotate the logo after it
// has spun onto display.
// Format is 45 bytes per frame. Using 10 bits per row, packed into 45 bytes (45*8 = 360 bits = 36*10). 
// The "Next piece" LEDs are skipped when displaying animations. Note that the first 18 rows are for the 
// half-brightness pixels. If the second 18 rows then also enable the same pixels, then they are full 
// brightness. So it's 2 "planes" per frame. If the second plane of pixels are used on their own, they 
// are also only 1/2 brightness. This uses little endian format. So bit 0 of the first byte is the
// top left pixel. Bit 4 is the top 5th pixel along, etc. This makes it fast to calculate pixel positions.
const uint8_t logoSpinner[8100] PROGMEM={

	0,0,0,0,0,0,0,8,3,0,192,240,48,12,1,0,0,0,0,0,0,0,0,0,0,0,0,0,0,0,0,32,8,6,1,0,64,0,0,0,0,0,0,0,0,
	0,0,0,0,0,0,0,8,3,0,192,240,48,12,1,0,0,0,0,0,0,0,0,0,0,0,0,0,0,0,0,32,8,6,1,0,64,0,0,0,0,0,0,0,0,
	0,0,0,0,0,0,0,8,3,1,192,240,48,12,1,0,0,0,0,0,0,0,0,0,0,0,0,0,0,0,0,32,8,0,1,0,64,0,0,0,0,0,0,0,0,
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	0,62,15,131,225,248,126,31,255,255,255,255,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0,
};

// Spinning cog animation. Accessed by holding LEFT when tuning power on. Users can scroll the Solder
// name left/right using buttons. Then the SPIN button will exit to game-of-life display. Using "SPIN"
// will restart the game-of-life with a random screen. "FAST DROP" will exit back to the main Tetris game.
const uint8_t cogSpinner[7380] PROGMEM={

	0,0,0,0,0,64,0,0,0,0,0,0,0,0,0,0,0,0,0,0,0,0,0,0,0,0,0,0,0,0,0,0,0,0,0,0,0,0,0,0,0,0,0,0,0,
	0,0,0,1,0,96,0,0,0,0,0,0,0,0,0,0,0,0,0,0,0,0,0,0,0,0,16,4,0,0,0,0,0,0,0,0,0,0,0,0,0,0,0,0,0,
	0,0,0,1,0,0,24,0,0,0,0,0,0,0,0,0,0,0,0,0,0,0,0,0,0,0,16,0,1,128,0,0,0,0,0,0,0,0,0,0,0,0,0,0,0,
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	0,0,0,0,0,0,0,0,0,0,0,0,0,0,0,0,0,0,0,0,4,25,0,0,0,0,0,0,0,0,0,0,0,0,0,0,0,0,0,0,0,0,0,0,0,
};


// Used in version one boards with a hardware on/off button to wake from sleep. This was a stupid idea
// in practice, as it mean the card was constantly being activated while in a wallet. So a slide switch
// was added in the next iteration.
ISR (INT0_vect){
}

// Swaps between fast and slow modes. Fast mode allows more CPU time outside of the LED updates,
// but can only have 1 brightness. Slow mode allows 2 brightnesses, but leaves less time for other
// processing. The Tetris game uses slow mode, as the player's current piece is shown brighter than
// the rest of the grid.
void setVideoMode(uint8_t mode){
	videoMode=mode;
	cli();
	//set timer1 interrupt at 1kHz
	TCCR1A = 0;// set entire TCCR1A register to 0
	TCCR1B = 0;// same for TCCR1B
	TCNT1  = 0;//initialize counter value to 0
	switch(mode){
		case VIDEO_MODE_FAST:
		OCR1A = TIMER_SPEED_FAST;// = (16*10^6) / (1000*8) - 1
		break;
		
		case VIDEO_MODE_SLOW:
		OCR1A = TIMER_SPEED_SLOW;// = (16*10^6) / (1000*8) - 1
		break;
	}	
	TCCR1B |= (1 << WGM12);
	// Set CS11 bit for 8 prescaler
	TCCR1B |= (1 << CS11);
	// enable timer compare interrupt
	TIMSK1 |= (1 << OCIE1A);
	sei();
}

// Only used in V1 boards. Newer boards use slide switch to enable power.
void goToSleep(void){
	/*
	DDRE=0;
	DDRB=0;
	DDRD=0;
	DDRC=0;
	
	PORTE=0x0f;
	PORTB=0xff;
	PORTD=0xff;
	PORTC=0xff;
	
	ADCSRA=0;
	power_all_disable ();
	*/
	cli();
	
	wdt_reset();
	/* Clear WDRF in MCUSR */
	MCUSR &= ~(1<<WDRF);
	/* Turn off WDT */
	WDTCSR = 0x00;
	
	// Disable brownout detection
	MCUCR = (1<<BODS) | (1<<BODSE);

	EICRA=0;			// LOW level interrupt
	EIMSK|=(1<<INT0);	// D2
	SREG|=(1<<7);		// Enable external interrupt
	
	set_sleep_mode(SLEEP_MODE_PWR_DOWN);
	sleep_enable();
	sleep_mode();
	sei();
	sleep_disable();
	EIMSK=0;
	
	while(getButtonState()){
		if(!butPressed(BUTTON_ON_OFF)){
			break;
		}
	}
	
}

// Used by matrix update timer to select the correct column driver pin, and polarity.
// The card only ever drives a maximum of 5 LEDs at a time, so uses very little power.
// Optimized for speed over size.
// In case you're wondering why the GPIO pin to row association seems so random, it's
// actually so that the board layout could have as few visible vias as possible, except
// for within the LED array where it's unavoidable on a 2 layer board. It's a business
// card, so function follows form to some extent!
void selectCol(void){
	
	// First disable all columns to prevent ghosting
	DDRE=0;
	DDRB&=~0b11100000;
	DDRD&=0;
	DDRC&=~0b001111;
	
	PORTE=0;
	PORTB&=~0b11100000;
	PORTD&=0;
	PORTC&=~0b001111;
	
	// Enable the correct column driver pin - note that we are driving both anodes and cathodes, 
	// so each row pin drives 2 columns
	switch(currentCol){

	case 36:
		PORTD&=~(1<<2);
		DDRD|=(1<<2);
		break;
	case 34:
		PORTB&=~(1<<6);
		DDRB|=(1<<6);
		break;
	case 32:
		PORTB|=(1<<6);
		DDRB|=(1<<6);
		break;
	case 30:
		PORTE&=~(1<<0);
		DDRE|=(1<<0);
		break;
	case 28:
		PORTE|=(1<<0);
		DDRE|=(1<<0);
		break;
	case 26:
		PORTD&=~(1<<3);
		DDRD|=(1<<3);
		break;
	case 24:
		PORTD|=(1<<3);
		DDRD|=(1<<3);
		break;
	case 22:
		PORTC&=~(1<<3);
		DDRC|=(1<<3);
		break;
	case 20:
		PORTC|=(1<<3);
		DDRC|=(1<<3);
		break;
	case 18:
		PORTD&=~(1<<5);
		DDRD|=(1<<5);
		break;
	case 16:
		PORTD|=(1<<5);
		DDRD|=(1<<5);
		break;
	case 14:
		PORTD&=~(1<<6);
		DDRD|=(1<<6);
		break;
	case 12:
		PORTD|=(1<<6);
		DDRD|=(1<<6);
		break;
	case 10:
		PORTD&=~(1<<7);
		DDRD|=(1<<7);
		break;
	case 8:
		PORTD|=(1<<7);
		DDRD|=(1<<7);
		break;
	case 6:
		PORTC&=~(1<<0);
		DDRC|=(1<<0);
		break;
	case 4:
		PORTC|=(1<<0);
		DDRC|=(1<<0);
		break;
	case 2:
		PORTB&=~(1<<5);
		DDRB|=(1<<5);
		break;
	case 0:
		PORTB|=(1<<5);
		DDRB|=(1<<5);
		break;


	case 37:
		PORTD|=(1<<2);
		DDRD|=(1<<2);
		break;
	case 35:
		PORTB&=~(1<<7);
		DDRB|=(1<<7);
		break;
	case 33:
		PORTB|=(1<<7);
		DDRB|=(1<<7);
		break;
	case 31:
		PORTE&=~(1<<1);
		DDRE|=(1<<1);
		break;
	case 29:
		PORTE|=(1<<1);
		DDRE|=(1<<1);
		break;
	case 27:
		PORTD&=~(1<<4);
		DDRD|=(1<<4);
		break;
	case 25:
		PORTD|=(1<<4);
		DDRD|=(1<<4);
		break;
	case 23:
		PORTD&=~(1<<1);
		DDRD|=(1<<1);
		break;
	case 21:
		PORTD|=(1<<1);
		DDRD|=(1<<1);
		break;
	case 19:
		PORTC&=~(1<<2);
		DDRC|=(1<<2);
		break;
	case 17:
		PORTC|=(1<<2);
		DDRC|=(1<<2);
		break;
	case 15:
		PORTC&=~(1<<1);
		DDRC|=(1<<1);
		break;
	case 13:
		PORTC|=(1<<1);
		DDRC|=(1<<1);
		break;
	case 11:
		PORTE&=~(1<<3);
		DDRE|=(1<<3);
		break;
	case 9:
		PORTE|=(1<<3);
		DDRE|=(1<<3);
		break;
	case 7:
		PORTE&=~(1<<2);
		DDRE|=(1<<2);
		break;
	case 5:
		PORTE|=(1<<2);
		DDRE|=(1<<2);
		break;
	case 3:
		PORTD&=~(1<<0);
		DDRD|=(1<<0);
		break;
	case 1:
		PORTD|=(1<<0);
		DDRD|=(1<<0);
		break;
	}
}

// Display update timer interrupt - selects the next row of 5 LEDs and displays the correct
// bitmap. If in SLOW mode, this is repeated for both planes. In FAST mode, only the first plane
// is used, and the timer speed reduced to allow more CPU processing time.
ISR(TIMER1_COMPA_vect) {
	if(++currentCol==MAX_COL){
		currentCol=0;
		if(switchBuffer){
			if(activeBuffer==1){
				activeBuffer=0;
				drawBuffer=1;
			}else{
				activeBuffer=1;
				drawBuffer=0;
			}
			switchBuffer=0;
		}
		if(videoMode==VIDEO_MODE_SLOW){
			if(++cBit>2)
				cBit=0;
			buffOff=(cBit<2?MAX_COL:0);
		}else{
			buffOff=0;
		}
	}
	DDRB=0;
	if((currentCol&2)||(currentCol==MAX_COL-2)){
		PORTB=buffer[activeBuffer][currentCol+buffOff];;
	}else{
		PORTB=~buffer[activeBuffer][currentCol+buffOff];;
	}
	selectCol();
	DDRB|=0b11111;
	
}

// Bare minimum setup at power on
 void setup(void){ 
	setVideoMode(VIDEO_MODE_SLOW);
	#if VER==1
	DDRD&=~(1<<BUT_ON_OFF);
	#endif 
}
 
 // Clear the current draw buffer
 void clearBuffer(void){
	for(uint8_t n=0;n<MAX_COL*2;n++){
		buffer[drawBuffer][n]=0;
	}
 }
 
 // Requests a buffer swap and waits until the LED driver interrupt has finished the current frame, 
 // and changes buffers to ensure we don't update a buffer that's being drawn, causing glitches.
 void flipBuffers(void){
	 switchBuffer=1;
	 while(switchBuffer);
 }
 
 // Just copies the contents of the active buffer back into the draw buffer
 void copyToBackBuffer(void){
	 for(uint8_t n=0;n<MAX_COL*2;n++){
		 buffer[drawBuffer][n]=buffer[activeBuffer][n];
	 }
 }
 
 // Loads raw data into both planes of the current draw buffer. Used by Tetris game to update
 // the display of the grid and overlay the player's piece
 void loadBuffer(uint8_t *data){
	 for(uint8_t n=0;n<MAX_COL*2;n++){
		 buffer[drawBuffer][n]=data[n];
	 }
 }

// Loads a frame of compressed data from program memory.
// A frame is 45 bytes in length.
 void displayVideoFrame(const uint8_t *data, uint16_t frameIX){
	 uint8_t bitPos=0;
	 uint8_t ix=0,ix2=0;
	 data+=(BYTES_PER_FRAME*frameIX);
 	 while(ix2<BYTES_PER_FRAME){
		uint8_t b=pgm_read_byte(data+ix2);
	
		switch(bitPos){
			case 0:
				break;
			case 1:
				b<<=1;
				break;
			case 2:
				b<<=2;
				break;
			case 3:
				b<<=3;
				break;
			case 4:
				b<<=4;
				b|=pgm_read_byte(data+ix2+1)>>4;
				break;
			case 5:
				b<<=5;
				b|=pgm_read_byte(data+ix2+1)>>3;
				break;
			case 6:
				b<<=6;
				b|=pgm_read_byte(data+ix2+1)>>2;
				break;
			case 7:
				b<<=7;
				b|=pgm_read_byte(data+ix2+1)>>1;
				break;
		}
		
		buffer[drawBuffer][ix]=b>>3;

		if(++ix==36)
			ix+=2;
			
		bitPos+=5;
		if(bitPos>7){
			bitPos-=8;
			++ix2;
		}
		  
 	 }
 }

// Returns 1 if the pixel at x,y in the active buffer is on
uint8_t getActive(int8_t x,int8_t y){
	uint8_t ret=0;
	if(x>9)
		x-=10;
	else if(x<0)
		x+=10;
	if(y>17)
		y-=18;
	else if(y<0)
		y+=18;
		
	y<<=1;
	if(x<5){
		ret=( (buffer[activeBuffer][y]&(1<<x)) ? 1 : 0 );
	}else{
		ret=( (buffer[activeBuffer][y+1]&(1<<(x-5))) ? 1: 0);
	}
	return ret;
}

// Returns 1 if the pixel at x,y in the draw buffer is on
uint8_t getDraw(int8_t x,int8_t y){
	uint8_t ret=0;
	if(x>9)
		x-=10;
	else if(x<0)
		x+=10;
	if(y>17)
		y-=18;
	else if(y<0)
		y+=18;
	y<<=1;
	if(x<5){
		ret=( (buffer[drawBuffer][y]&(1<<x)) ? 1 : 0 );
	}else{
		ret=( (buffer[drawBuffer][y+1]&(1<<(x-5))) ? 1: 0);
	}
	return ret;
}

// Plot pixel of brightness 0,1, or 2 in active buffer
void plotActive(int8_t x, int8_t y, uint8_t c){
	if(x>9 || x<0 || y<0 || y>17)
		return;
	y<<=1;
	switch(c){
		case 0:
			if(x<5){
				buffer[activeBuffer][y]&=~(1<<x);
				buffer[activeBuffer][y+MAX_COL]&=~(1<<x);
			}else{
				buffer[activeBuffer][y+1]&=~(1<<(x-5));
				buffer[activeBuffer][y+1+MAX_COL]&=~(1<<(x-5));
			}
			break;
		case 1:
			if(x<5){
				buffer[activeBuffer][y]|=(1<<x);
				buffer[activeBuffer][y+MAX_COL]&=~(1<<x);
			}else{
				buffer[activeBuffer][y+1]|=(1<<(x-5));
				buffer[activeBuffer][y+1+MAX_COL]&=~(1<<(x-5));
			}
			break;
		case 2:
			if(x<5){
				buffer[activeBuffer][y]|=(1<<x);
				buffer[activeBuffer][y+MAX_COL]|=(1<<x);
			}else{
				buffer[activeBuffer][y+1]|=(1<<(x-5));
				buffer[activeBuffer][y+1+MAX_COL]|=(1<<(x-5));
			}
			break;
	}
}

// Plot pixel of brightness 0,1, or 2 in draw buffer
void plot(int8_t x, int8_t y, uint8_t c){
	if(x>9 || x<0 || y<0 || y>17)
	return;
	y<<=1;
	switch(c){
		case 0:
		if(x<5){
			buffer[drawBuffer][y]&=~(1<<x);
			buffer[drawBuffer][y+MAX_COL]&=~(1<<x);
			}else{
			buffer[drawBuffer][y+1]&=~(1<<(x-5));
			buffer[drawBuffer][y+1+MAX_COL]&=~(1<<(x-5));
		}
		break;
		case 1:
		if(x<5){
			buffer[drawBuffer][y]|=(1<<x);
			buffer[drawBuffer][y+MAX_COL]&=~(1<<x);
			}else{
			buffer[drawBuffer][y+1]|=(1<<(x-5));
			buffer[drawBuffer][y+1+MAX_COL]&=~(1<<(x-5));
		}
		break;
		case 2:
		if(x<5){
			buffer[drawBuffer][y]|=(1<<x);
			buffer[drawBuffer][y+MAX_COL]|=(1<<x);
			}else{
			buffer[drawBuffer][y+1]|=(1<<(x-5));
			buffer[drawBuffer][y+1+MAX_COL]|=(1<<(x-5));
		}
		break;
	}
}

// Plot pixel at x,y in draw buffer if dOff is 3. Used by the initial rotating border animation/
void doPlot(int8_t x,int8_t y,uint8_t *dOdd){
	if(*dOdd==3){
		plot(x,y,0);
	}else{
		plot(x,y,2);
	}
	if(++*dOdd==4){
		*dOdd=0;
	}
}

// Draws the rotating border animation at zoom level "amp".
void drawSpinner(uint8_t dotOff, uint8_t amp){
	amp=5-amp;
	uint8_t dOdd=dotOff;
	for(uint8_t n=0+amp;n<10-amp;n++){
		doPlot(n,0+amp,&dOdd);
	}
	for(uint8_t n=1+amp;n<18-amp;n++){
		doPlot(9-amp,n,&dOdd);
	}
	for(int8_t n=8-amp;n>-1+amp;n--){
		doPlot(n,17-amp,&dOdd);
	}
	for(int8_t n=16-amp;n>0+amp;n--){
		doPlot(0+amp,n,&dOdd);
	}
}

// Draw a vertical or horizontal line in brightness 0,1, or 2
void drawLine(int8_t x, int8_t y, int8_t w, int8_t h, uint8_t c){
	if(w>0){
		for(int8_t n=0;n<w;n++){
			plot(x+n,y,c);
		}
	}else{
		for(int8_t n=0;n<h;n++){
			plot(x,y+n,c);
		}
	}
}

// Draws a solid block of brightness 0,1, or 2
void drawBlock(int8_t x, int8_t y, int8_t w, int8_t h, uint8_t c){
	if(x>9 || y>17)
		return;
	int8_t sx=x;
	int8_t sy=y;
	if(sx<0){
		w+=sx;
		if(w<1)
			return;
		sx=0;
	}
	if(sy<0){
		h+=sy;
		if(h<1)
			return;
		sy=0;
	}
	w=sx+w;
	h=sy+h;
	if(w>10)
		w=10;
	if(h>18)
		h=18;
	for(int8_t n=sx;n<w;n++){
		for(int8_t i=sy;i<h;i++){
			plot(n,i,c);
		}
	}
}

// Draws big chars at a Y position - they are always centred on the display for speed
void drawChar(uint8_t charIX,int16_t yPos, uint8_t c){
	if(yPos>17 || yPos<-7 || c==0)
		return;
	uint16_t ix=charIX<<4;
	yPos<<=1;
	for(uint8_t n=0;n<8;n++){
		if(yPos>-1 && yPos<36){
			buffer[drawBuffer][yPos]=charDef[ix];
			buffer[drawBuffer][yPos+1]=charDef[ix+1];
			if(c>1){
				buffer[drawBuffer][yPos+MAX_COL]=charDef[ix];
				buffer[drawBuffer][yPos+1+MAX_COL]=charDef[ix+1];
			}
		}
		yPos+=2;
		ix+=2;
	}
}

// Draw a vertical string at position y - used for initial title, and score display
void drawText(char *s,int16_t yPos, uint8_t c){
	char chr;
	while(*s){
		chr=*s++;
		if(chr>='0' && chr<='9'){
			drawChar(chr+25-'0',yPos,c);
		}else if(chr>='A' && chr<='Z'){
			drawChar(chr-'A',yPos,c);
		}
		yPos+=9;
	}
}

// Fast blit for horizontal lines spanning full width. Used for the "screen collapse" animation
void fastHLine(int8_t yPos,uint8_t c){
	if(yPos<0 || yPos>17)
		return;
	yPos<<=1;
	switch(c){
		case 0:
			buffer[drawBuffer][yPos]=0;
			buffer[drawBuffer][yPos+1]=0;
			buffer[drawBuffer][yPos+MAX_COL]=0;
			buffer[drawBuffer][yPos+1+MAX_COL]=0;
		break;
		case 1:
			buffer[drawBuffer][yPos]=0b11111;
			buffer[drawBuffer][yPos+1]=0b11111;
			buffer[drawBuffer][yPos+MAX_COL]=0;
			buffer[drawBuffer][yPos+1+MAX_COL]=0;
		break;
		case 2:
			buffer[drawBuffer][yPos]=0b11111;
			buffer[drawBuffer][yPos+1]=0b11111;
			buffer[drawBuffer][yPos+MAX_COL]=0b11111;
			buffer[drawBuffer][yPos+1+MAX_COL]=0b11111;
		break;
	}
}

// Guess :-) Score and hi-score display should have really been in the Tetris game file, but
// I was going to also add a scrolling maze game, so wanted to share this. Turned out to only
// have the Tetris game (well, and Game of Life) so not really needed here.
void showScore(uint16_t s, uint8_t type){
	char sA[6]="";
	int8_t ix=5;
	while(s>0){
		sA[ix--]=s%10;
		s/=10;
	}
	if(ix<5)
		++ix;
	const uint8_t textLen=(type==0?5:2);
	const uint8_t numOff=(type==0?50:23);
	int16_t yPos=18;
	int16_t sHeight=((textLen+7-ix)*9)-4;
	while(yPos-->-sHeight){
		clearBuffer();
		if(type==0){
			drawText("SCORE",yPos,1);
		}else{
			drawText("HI",yPos,1);
		}
		s=0;
		for(uint8_t n=ix;n<6;n++){
			drawChar(sA[n]+26,yPos+numOff+s,2);
			s+=9;
		}
		
		flipBuffers();
		getButtonState();
		if(butPressed(BUTTON_ON_OFF)){
			clearBuffer();
			flipBuffers();
			waitBut();
			return;
		}
		_delay_ms(SHOW_SCORE_DELAY);
	}
}

// Shows the "menu". Initially this would have shown different games,
// but I ran out of time on the project, so it auto-jumps out to the
// Tetris game
uint8_t doMenu(void){
	uint8_t dotOff=0;
	uint8_t amp=0;
	uint16_t cnt=0;
	int8_t logoOff=-4;
	
	while(1){

		clearBuffer();

		if(cnt%2){
			if(++dotOff==4)
				dotOff=0;
			if(amp<5 && cnt<15)
				++amp;
		}

		if(cnt>15 && cnt<30){
			if(logoOff<6)
				++logoOff;
		}else if(cnt>40 && cnt<55){
			if(logoOff>-4)
				--logoOff;
		}
		if(cnt>15 && cnt<55){
			drawBlock(3,logoOff,2,4, (logoOff==6?2:1));
			drawBlock(5,14-logoOff,2,4, (logoOff==6?2:1));
		}else if(cnt==55){
			logoOff=18;
		}else if(cnt>55 && cnt<130){
			if(logoOff>-54)
				--logoOff;
			drawText("TETRIS",logoOff, 1);
		}else if(cnt>130 && cnt<136){
			if(amp>0)
				--amp;
		}else if(cnt==136){
			logoOff=-8;
		}else if(cnt>136 && cnt<142){
			drawText("GO",logoOff, 2);
			if(logoOff<0){
				logoOff+=2;
			}
		}else if(cnt>141 && cnt<155){
			if(cnt%2){
				drawText("GO",logoOff, 2);
			}
		}else if(cnt==155){
			clearBuffer();
			flipBuffers();
			return 1;
		}
		
		if(cnt<136){
			drawSpinner(dotOff,amp);
		}

		flipBuffers();
		++cnt;
		getButtonState();
		if(butPressed(BUTTON_ON_OFF)){
			clearBuffer();
			flipBuffers();
			waitBut();
			return 0;
		}
		_delay_ms(INTRO_DELAY);
	}
	return 1;
}

// Check if a specific button is pressed
uint8_t butPressed(uint8_t which){
	return butState&(1<<which);
}

// Wait until no buttons are pressed
void waitBut(void){
	uint16_t reps=0;
	_delay_ms(10);
	while(1){
		++reps;
		getButtonState();
		if(!butState){
			srand(reps);
			_delay_ms(10);
			return;
		}
	}
}

// Populates a bit field with current button press states
uint8_t getButtonState(void){
	butState=0;
	// Set up ADC to use AVCC, 8 bit conversion, and set mux to C5
	ADMUX = (1<<REFS0) + (1<<ADLAR) + 0b101;
	// Enable MUX, start conversion, with divisor of 128 - low speed
	ADCSRA = (1<<ADEN)+(1<<ADPS2)+(1<<ADPS1); //+(1<<ADPS0);
	ADCSRA|=(1<<ADSC);
	while(ADCSRA&(1<<ADSC));	// Wait for conversion
	uint8_t v=ADCH>>4;
	if(v<FAST_DROP_ADC)	// fast drop button
		butState|=(1<<BUTTON_FAST_DROP);
	else if(v<SPIN_ADC)
		butState|=(1<<BUTTON_SPIN);
		
	// Set up ADC to use AVCC, 8 bit conversion, and set mux to C4
	ADMUX = (1<<REFS0) + (1<<ADLAR) + 0b100;
	ADCSRA|=(1<<ADSC);
	while(ADCSRA&(1<<ADSC));	// Wait for conversion
	v=ADCH>>4;
	ADCSRA=0;	// Disable ADC to save power
#if(VER==1)
	if(v<DOWN_ADC)	// fast drop button
		butState|=(1<<BUTTON_DOWN);
	else if(v<LEFT_ADC)
		butState|=(1<<BUTTON_LEFT);
	else if(v<RIGHT_ADC)
		butState|=(1<<BUTTON_RIGHT);
	if((PIND&(1<<BUT_ON_OFF))==0)
		butState|=(1<<BUTTON_ON_OFF);
#elif(VER==2)
	if(v<RIGHT_ADC)
		butState|=(1<<BUTTON_RIGHT);
	else if(v<LEFT_ADC)
		butState|=(1<<BUTTON_LEFT);
	else if(v<DOWN_ADC)	// fast drop button
		butState|=(1<<BUTTON_DOWN);
#endif
	return butState;
}

// For debugging, displays the current button states on the display using blocks
void showButtonStates(void){
	uint8_t side=0;
	while(1){
		clearBuffer();
		getButtonState();
		for(uint8_t n=0;n<6;n++){
			if(butState&(1<<n)){
				drawBlock(0,n*3,2,2, 2);
			}
		}
		plot(9,side, 2);
		if(++side==18)
			side=0;
		flipBuffers();
		_delay_ms(1);
	}
}

// Test the ADC values of buttons. Line 1262 (0b100) needs changing if you want to check
// the right or left buttons.
void testButtons(void){
	uint8_t side=0;
	while(1){
		clearBuffer();
		// Set up ADC to use AVCC, 8 bit conversion, and set mux to C4
		ADMUX = (1<<REFS0) + (1<<ADLAR) + 0b100;
		// Enable MUX, start conversion, with divisor of 128 - low speed
		ADCSRA = (1<<ADEN)+(1<<ADPS2)+(1<<ADPS1)+(1<<ADPS0);
		ADCSRA|=(1<<ADSC);
		while(ADCSRA&(1<<ADSC));	// Wait for conversion
		uint8_t v=ADCH;
		drawBlock(0,0,9,v>>4, 2);
		plot(9,side, 2);
		if(++side==18)
			side=0;
		flipBuffers();
		_delay_ms(20);
	}	
}

// Perform shutdown animation. Was used when card went to sleep in V1 boards,
// but now displays after game ends.
void shutdown(void){

	for(uint8_t n=0;n<9;n++){
		copyToBackBuffer();
		fastHLine(n,2);
		fastHLine(17-n,2);
		fastHLine(n-1,1);
		fastHLine(18-n,1);
		flipBuffers();
		_delay_ms(5);
	}
	_delay_ms(30);
	for(uint8_t n=0;n<9;n++){
		copyToBackBuffer();
		fastHLine(n,0);
		fastHLine(17-n,0);
		flipBuffers();
	}
	for(int8_t n=0;n<10;n++){
		clearBuffer();
		if(n%2){
			fastHLine(8,2);
			fastHLine(9,2);
		}
		flipBuffers();
		_delay_ms(3);
	}
	for(int8_t n=0;n<5;n++){
		clearBuffer();
		drawLine(n,8,10-(n*2),0, 2);
		drawLine(n,9,10-(n*2),0, 2);
		flipBuffers();
		_delay_ms(1);
	}
	clearBuffer();
	flipBuffers();
}

// Just updates the display slowly to show each 5 pixel section in isolation for debugging/testing
void testDisplay(void){
	uint8_t seg=0;
	while(1){
		clearBuffer();
		buffer[drawBuffer][seg]=0b11111;
		flipBuffers();
		if(++seg==MAX_COL)
			seg=0;
		_delay_ms(5);
	}
}

// Shows the cog spinner Solder animation. This is accessed by holding down LEFT while turning on
// the power, then releasing LEFT.
void spinCog(void){
	int16_t ix=0;
	while(1){
		displayVideoFrame(cogSpinner,ix);
		flipBuffers();
		if(++ix==150)
			break;
	}

	while(1){
		uint8_t bState=getButtonState();
		if(bState){
			if(butPressed(BUTTON_RIGHT)){
				--ix;
				if(ix<=100){
					ix=150;
				}
			}else if(butPressed(BUTTON_LEFT)){
				++ix;
				if(ix>=150){
					ix=100;
				}
			}
			if(butPressed(BUTTON_SPIN)){
				break;
			}
			
			displayVideoFrame(cogSpinner,ix);
			flipBuffers();
		}
	}
	
	while(ix<165){
		displayVideoFrame(cogSpinner,ix);
		flipBuffers();
		++ix;
	}
	
}

// Displays the 3d Solder Logo animation. LEFT and RIGHT can be used to rotate the logo
// after it appears. SPIN exits back to the game. As an aside, this was initially rendered
// in 3D on the card using pseudo-polygons, but as I also wanted to add the cog animation,
// I was a bit short on space, and so now render it as another animation. Sneaky :)
void spinLogo(void){
	int16_t ix=0;
	while(1){
		displayVideoFrame(logoSpinner,ix);
		flipBuffers();
		++ix;
		if(ix>=180){
			ix=120;
			displayVideoFrame(logoSpinner,ix);	
			flipBuffers();
			break;
		}
	}	

	while(1){
		uint8_t bState=getButtonState();
		if(bState){
			if(butPressed(BUTTON_LEFT)){
				--ix;
				if(ix<=120){
					ix=179;
				}
			}else if(butPressed(BUTTON_RIGHT)){
				++ix;
				if(ix>=180){
					ix=120;
				}
			}
			if(butPressed(BUTTON_SPIN)){
				break;
			}
			
			displayVideoFrame(logoSpinner,ix);
			flipBuffers();
		}
	}
	
	while(ix>0){
		displayVideoFrame(logoSpinner,ix);
		flipBuffers();
		--ix;
	}
}
